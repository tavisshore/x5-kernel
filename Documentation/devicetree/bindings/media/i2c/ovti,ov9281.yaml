## Documentation/devicetree/bindings/media/i2c/ovti,ov9281.yaml
```yaml
# SPDX-License-Identifier: (GPL-2.0-only OR BSD-2-Clause)
%YAML 1.2
---
$id: http://devicetree.org/schemas/media/i2c/ovti,ov9281.yaml#
$schema: http://devicetree.org/meta-schemas/core.yaml#

title: OmniVision OV9281 Sensor

maintainers:
  - OmniVision kernel team <kernel@ovt.com>

description:
  OV9281 sensor is an OmniVision monochrome global shutter CMOS active pixel
  digital image sensor with an active array size of 1296H x 816V. It is
  programmable through I2C interface. The I2C client address is fixed to
  0x60/0x70 as per sensor data sheet. Image data is sent through MIPI CSI-2.

properties:
  compatible:
    const: ovti,ov9281

  reg:
    description: I2C address
    maxItems: 1

  assigned-clocks: true
  assigned-clock-parents: true
  assigned-clock-rates: true

  clocks:
    description: Clock frequency from 6 to 27MHz
    maxItems: 1

  avdd-supply:
    description: Analog voltage supply, 2.8V.

  dovdd-supply:
    description: Digital I/O voltage supply, 1.8V.

  dvdd-supply:
    description: Digital core voltage supply, 1.2V.

  reset-gpios:
    description: Reference to the GPIO connected to the XCLR pin, if any.
    maxItems: 1

  port:
    additionalProperties: false
    $ref: /schemas/graph.yaml#/$defs/port-base

    properties:
      endpoint:
        $ref: /schemas/media/video-interfaces.yaml#
        unevaluatedProperties: false

        properties:
          data-lanes: true
          link-frequencies: true

        required:
          - data-lanes
          - link-frequencies

    required:
      - endpoint

required:
  - compatible
  - reg
  - clocks
  - port

additionalProperties: false

examples:
  - |
    #include <dt-bindings/gpio/gpio.h>

    i2c0 {
        #address-cells = <1>;
        #size-cells = <0>;

        camera@60 {
            compatible = "ovti,ov9281";
            reg = <0x60>;
            clocks = <&ov9281_clk>;

            assigned-clocks = <&ov9281_clk>;
            assigned-clock-parents = <&ov9281_clk_parent>;
            assigned-clock-rates = <24000000>;

            reset-gpios = <&gpio0 5 GPIO_ACTIVE_LOW>;

            avdd-supply = <&vcc_2v8>;
            dovdd-supply = <&vcc_1v8>;
            dvdd-supply = <&vcc_1v2>;

            port {
                ov9281: endpoint {
                    remote-endpoint = <&cam>;
                    data-lanes = <1 2>;
                    link-frequencies = /bits/ 64 <400000000>;
                };
            };
        };
    };
...
```
